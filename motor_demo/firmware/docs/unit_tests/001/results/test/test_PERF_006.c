/* GENERATED by src/agents/unit_test_agent - review before relying on it.
 *
 * Requirement PERF-006: The hold duration at 10 Hz and up to 20% PWM shall be 10 seconds.
 * Verified by: hardware / instrument
 * Derived from: firmware/app/app.c, firmware/configs/app_config.h, firmware/modules/motor_sequence/motor_sequence.c, firmware/modules/motor_sequence/motor_sequence.h
 * Rationale: The assertions follow motor_sequence_step's boundaries: 3 s boot delay plus 5 s startup ramp enters hold at 8 s, and the 10,000 ms hold ends at 18 s. app_set_profile requests 10 Hz and 0.20 amplitude throughout the 1,000 hold iterations, while the following iteration enters the shutdown-ramp calculation; the mocked sine output is forwarded by app_drive_sine to the recorded motor duty values.
 */

#include "unity.h"
#include "mock_motor_platform.h"
#include "mock_safety_platform.h"
#include "mock_sine_control.h"
#include "app.h"
#include "app_config.h"
#include "logger.h"
#include "motor_platform.h"
#include "motor_sequence.h"
#include "safety_platform.h"
#include "sine_control.h"

#include <stdbool.h>
#include <string.h>

#define MAX_SEQUENCE_CALLS 2000

static float profile_frequency[MAX_SEQUENCE_CALLS];
static float profile_amplitude[MAX_SEQUENCE_CALLS];
static float drive_u[MAX_SEQUENCE_CALLS];
static float drive_v[MAX_SEQUENCE_CALLS];
static float drive_w[MAX_SEQUENCE_CALLS];
static int profile_calls;
static int drive_calls;

static void sine_control_set_profile_callback(
    sine_control_state_t *state,
    float frequency_hz,
    float amplitude,
    int cmock_num_calls)
{
    (void)state;
    (void)cmock_num_calls;

    if (profile_calls < MAX_SEQUENCE_CALLS) {
        profile_frequency[profile_calls] = frequency_hz;
        profile_amplitude[profile_calls] = amplitude;
    }
    profile_calls++;
}

static sine_control_output_t sine_control_output_callback(
    const sine_control_state_t *state,
    int cmock_num_calls)
{
    sine_control_output_t output;

    (void)state;
    (void)cmock_num_calls;

    output.duty_u = 0.20F;
    output.duty_v = 0.20F;
    output.duty_w = 0.20F;
    return output;
}

static x_nucleo_ihm16m1_status_t motor_platform_drive_callback(
    float duty_u,
    float duty_v,
    float duty_w,
    int cmock_num_calls)
{
    (void)cmock_num_calls;

    if (drive_calls < MAX_SEQUENCE_CALLS) {
        drive_u[drive_calls] = duty_u;
        drive_v[drive_calls] = duty_v;
        drive_w[drive_calls] = duty_w;
    }
    drive_calls++;
    return X_NUCLEO_IHM16M1_OK;
}

static x_nucleo_ihm16m1_status_t safety_platform_check_fault_callback(
    bool *fault,
    int cmock_num_calls)
{
    (void)cmock_num_calls;

    if (fault != NULL) {
        *fault = false;
    }
    return X_NUCLEO_IHM16M1_OK;
}

void setUp(void)
{
    memset(profile_frequency, 0, sizeof(profile_frequency));
    memset(profile_amplitude, 0, sizeof(profile_amplitude));
    memset(drive_u, 0, sizeof(drive_u));
    memset(drive_v, 0, sizeof(drive_v));
    memset(drive_w, 0, sizeof(drive_w));
    profile_calls = 0;
    drive_calls = 0;
}

void tearDown(void)
{
}

void test_PERF_006_01(void)
{
    int index;

    motor_platform_led_on_Ignore();
    sine_control_init_Ignore();
    sine_control_set_profile_StubWithCallback(sine_control_set_profile_callback);
    sine_control_output_StubWithCallback(sine_control_output_callback);
    sine_control_update_Ignore();

    safety_platform_init_ExpectAndReturn(X_NUCLEO_IHM16M1_OK);
    motor_platform_init_ExpectAndReturn(X_NUCLEO_IHM16M1_OK);
    safety_platform_check_fault_StubWithCallback(safety_platform_check_fault_callback);
    motor_platform_enable_ExpectAndReturn(true, X_NUCLEO_IHM16M1_OK);
    motor_platform_drive_StubWithCallback(motor_platform_drive_callback);
    motor_platform_delay_ms_Ignore();
    safety_platform_watchdog_refresh_Ignore();
    safety_platform_disable_ExpectAndReturn(X_NUCLEO_IHM16M1_OK);

    app_start();

    /* The application enters its main loop at 3 s and executes every 10 ms. */
    TEST_ASSERT_EQUAL_INT(1700, profile_calls);
    TEST_ASSERT_EQUAL_INT(1700, drive_calls);

    /* Profile call 500 is t=8 s, and call 1499 is the last call before t=18 s. */
    for (index = 500; index < 1500; index++) {
        TEST_ASSERT_FLOAT_WITHIN(0.0001F, 10.0F, profile_frequency[index]);
        TEST_ASSERT_FLOAT_WITHIN(0.0001F, 0.20F, profile_amplitude[index]);
        TEST_ASSERT_TRUE(drive_u[index] <= 0.20F);
        TEST_ASSERT_TRUE(drive_v[index] <= 0.20F);
        TEST_ASSERT_TRUE(drive_w[index] <= 0.20F);
    }

    /* At t=18 s the sequence reaches the shutdown boundary; the next
       profile call has begun the shutdown ramp. */
    TEST_ASSERT_FLOAT_WITHIN(0.0001F, 10.0F, profile_frequency[1500]);
    TEST_ASSERT_FLOAT_WITHIN(0.0001F, 0.20F, profile_amplitude[1500]);
    TEST_ASSERT_TRUE(profile_frequency[1501] < 10.0F);
    TEST_ASSERT_TRUE(profile_amplitude[1501] < 0.20F);
}
