/* GENERATED by src/agents/unit_test_agent - review before relying on it.
 *
 * Requirement FR-006: The firmware shall run the motor for the configured demonstration duration.
 * Verified by: hardware / instrument
 * Derived from: firmware/app/app.c, firmware/configs/app_config.h, firmware/modules/motor_sequence/motor_sequence.c, firmware/modules/motor_sequence/motor_sequence.h
 * Rationale: The failure was caused by the test omitting an expectation policy for sine_control_update, although app_start calls it once per iteration in the main loop. The assertions remain derived from app_start's app_drive_sine call and app_set_profile branches: calls 500–1499 correspond to the hold interval, while call 1500 is the first shutdown-boundary profile and call 1501 must ramp downward.
 */

#include "unity.h"
#include "mock_motor_platform.h"
#include "mock_safety_platform.h"
#include "mock_sine_control.h"
#include "app.h"
#include "app_config.h"
#include "logger.h"
#include "motor_platform.h"
#include "motor_sequence.h"
#include "safety_platform.h"
#include "sine_control.h"

#include <stdbool.h>
#include <stdint.h>
#include <string.h>

#define EXPECTED_RUN_CALLS 1700U
#define HOLD_START_CALL 500U
#define HOLD_END_CALL 1499U
#define SHUTDOWN_START_CALL 1500U
#define SHUTDOWN_NEXT_CALL 1501U

static unsigned int drive_calls;
static float drive_duty_u[EXPECTED_RUN_CALLS];
static float profile_frequency[EXPECTED_RUN_CALLS];
static float profile_amplitude[EXPECTED_RUN_CALLS];
static unsigned int profile_calls;

static void sine_control_set_profile_callback(sine_control_state_t *state,
                                               float frequency_hz,
                                               float amplitude,
                                               int cmock_num_calls)
{
    (void)cmock_num_calls;

    if (profile_calls < EXPECTED_RUN_CALLS) {
        profile_frequency[profile_calls] = frequency_hz;
        profile_amplitude[profile_calls] = amplitude;
    }
    profile_calls++;

    if (state != NULL) {
        state->frequency_hz = frequency_hz;
        state->amplitude = amplitude;
    }
}

static sine_control_output_t sine_control_output_callback(
    const sine_control_state_t *state,
    int cmock_num_calls)
{
    sine_control_output_t output;
    (void)cmock_num_calls;

    output.duty_u = (state != NULL) ? state->amplitude : 0.0F;
    output.duty_v = output.duty_u;
    output.duty_w = output.duty_u;
    return output;
}

static x_nucleo_ihm16m1_status_t motor_platform_drive_callback(
    float duty_u,
    float duty_v,
    float duty_w,
    int cmock_num_calls)
{
    (void)duty_v;
    (void)duty_w;
    (void)cmock_num_calls;

    if (drive_calls < EXPECTED_RUN_CALLS) {
        drive_duty_u[drive_calls] = duty_u;
    }
    drive_calls++;
    return X_NUCLEO_IHM16M1_OK;
}

static x_nucleo_ihm16m1_status_t safety_platform_check_fault_callback(
    bool *fault,
    int cmock_num_calls)
{
    (void)cmock_num_calls;

    if (fault != NULL) {
        *fault = false;
    }
    return X_NUCLEO_IHM16M1_OK;
}

void setUp(void)
{
    drive_calls = 0U;
    profile_calls = 0U;
    memset(drive_duty_u, 0, sizeof(drive_duty_u));
    memset(profile_frequency, 0, sizeof(profile_frequency));
    memset(profile_amplitude, 0, sizeof(profile_amplitude));

    motor_platform_led_on_Expect();
    sine_control_init_Ignore();
    safety_platform_init_ExpectAndReturn(X_NUCLEO_IHM16M1_OK);
    motor_platform_init_ExpectAndReturn(X_NUCLEO_IHM16M1_OK);
    motor_platform_enable_ExpectAndReturn(true, X_NUCLEO_IHM16M1_OK);
    safety_platform_disable_ExpectAndReturn(X_NUCLEO_IHM16M1_OK);

    safety_platform_check_fault_StubWithCallback(
        safety_platform_check_fault_callback);
    sine_control_set_profile_StubWithCallback(
        sine_control_set_profile_callback);
    sine_control_output_StubWithCallback(sine_control_output_callback);
    motor_platform_drive_StubWithCallback(motor_platform_drive_callback);

    sine_control_update_Ignore();
    safety_platform_watchdog_refresh_Ignore();
    motor_platform_delay_ms_Ignore();
}

void tearDown(void)
{
}

void test_FR_006_01(void)
{
    unsigned int call;

    app_start();

    TEST_ASSERT_EQUAL_INT((int)EXPECTED_RUN_CALLS, (int)drive_calls);
    TEST_ASSERT_EQUAL_INT((int)EXPECTED_RUN_CALLS, (int)profile_calls);

    for (call = HOLD_START_CALL; call <= HOLD_END_CALL; call++) {
        TEST_ASSERT_FLOAT_WITHIN(0.0001F, APP_MOTOR_RUN_AMPLITUDE,
                                 drive_duty_u[call]);
    }

    TEST_ASSERT_FLOAT_WITHIN(0.0001F, APP_MOTOR_RUN_FREQUENCY_HZ,
                             profile_frequency[SHUTDOWN_START_CALL]);
    TEST_ASSERT_FLOAT_WITHIN(0.0001F, APP_MOTOR_RUN_AMPLITUDE,
                             profile_amplitude[SHUTDOWN_START_CALL]);
    TEST_ASSERT_TRUE(profile_frequency[SHUTDOWN_NEXT_CALL] <
                     profile_frequency[SHUTDOWN_START_CALL]);
    TEST_ASSERT_TRUE(profile_amplitude[SHUTDOWN_NEXT_CALL] <
                     profile_amplitude[SHUTDOWN_START_CALL]);
}
