/* GENERATED by src/agents/unit_test_agent - review before relying on it.
 *
 * Requirement PERF-007: The shutdown ramp duration shall be 2 seconds.
 * Verified by: hardware / instrument
 * Derived from: firmware/app/app.c, firmware/configs/app_config.h, firmware/modules/motor_sequence/motor_sequence.c, firmware/modules/motor_sequence/motor_sequence.h
 * Rationale: The assertions at profile/drive index 1500 represent the 18.0 s iteration after the 3.0 s boot delay, where app_set_profile should enter the shutdown ramp at full run frequency and amplitude. The final recorded drive before motor_sequence_step reaches STOPPED represents the end of the 20.0 s sequence and is asserted to have zero frequency, amplitude, and PWM duties; the supplied implementation doe
 */

#include "unity.h"
#include "mock_motor_platform.h"
#include "mock_safety_platform.h"
#include "mock_sine_control.h"
#include "app.h"
#include "app_config.h"
#include "logger.h"
#include "motor_platform.h"
#include "motor_sequence.h"
#include "safety_platform.h"
#include "sine_control.h"

#include <string.h>

static float profile_frequency[2000];
static float profile_amplitude[2000];
static float drive_u[2000];
static float drive_v[2000];
static float drive_w[2000];
static int profile_calls;
static int drive_calls;

static void sine_control_set_profile_callback(sine_control_state_t *state,
                                               float frequency_hz,
                                               float amplitude,
                                               int cmock_num_calls)
{
    (void)cmock_num_calls;

    if (profile_calls < 2000) {
        profile_frequency[profile_calls] = frequency_hz;
        profile_amplitude[profile_calls] = amplitude;
    }
    profile_calls++;

    if (state != NULL) {
        state->frequency_hz = frequency_hz;
        state->amplitude = amplitude;
    }
}

static sine_control_output_t sine_control_output_callback(
    const sine_control_state_t *state,
    int cmock_num_calls)
{
    sine_control_output_t output = {0.0F, 0.0F, 0.0F};
    (void)cmock_num_calls;

    if (state != NULL) {
        output.duty_u = state->amplitude;
        output.duty_v = state->amplitude;
        output.duty_w = state->amplitude;
    }

    return output;
}

static x_nucleo_ihm16m1_status_t motor_platform_drive_callback(
    float duty_u,
    float duty_v,
    float duty_w,
    int cmock_num_calls)
{
    (void)cmock_num_calls;

    if (drive_calls < 2000) {
        drive_u[drive_calls] = duty_u;
        drive_v[drive_calls] = duty_v;
        drive_w[drive_calls] = duty_w;
    }
    drive_calls++;

    return X_NUCLEO_IHM16M1_OK;
}

void setUp(void)
{
    memset(profile_frequency, 0, sizeof(profile_frequency));
    memset(profile_amplitude, 0, sizeof(profile_amplitude));
    memset(drive_u, 0, sizeof(drive_u));
    memset(drive_v, 0, sizeof(drive_v));
    memset(drive_w, 0, sizeof(drive_w));
    profile_calls = 0;
    drive_calls = 0;

    motor_platform_led_on_Ignore();
    motor_platform_init_IgnoreAndReturn(X_NUCLEO_IHM16M1_OK);
    motor_platform_enable_IgnoreAndReturn(X_NUCLEO_IHM16M1_OK);
    motor_platform_delay_ms_Ignore();

    safety_platform_init_IgnoreAndReturn(X_NUCLEO_IHM16M1_OK);
    safety_platform_check_fault_IgnoreAndReturn(X_NUCLEO_IHM16M1_OK);
    safety_platform_disable_IgnoreAndReturn(X_NUCLEO_IHM16M1_OK);
    safety_platform_watchdog_refresh_Ignore();

    sine_control_init_Ignore();
    sine_control_set_profile_StubWithCallback(sine_control_set_profile_callback);
    sine_control_update_Ignore();
    sine_control_output_StubWithCallback(sine_control_output_callback);
    motor_platform_drive_StubWithCallback(motor_platform_drive_callback);
}

void tearDown(void)
{
}

void test_PERF_007_01(void)
{
    app_start();

    /* At 10 ms per iteration, index 1500 corresponds to t = 18.00 s,
       and index 1699 is the final drive before the sequence reaches 20 s. */
    TEST_ASSERT_EQUAL_INT(1700, profile_calls);
    TEST_ASSERT_EQUAL_INT(1700, drive_calls);

    TEST_ASSERT_FLOAT_WITHIN(0.0001F, APP_MOTOR_RUN_FREQUENCY_HZ,
                             profile_frequency[1500]);
    TEST_ASSERT_FLOAT_WITHIN(0.0001F, APP_MOTOR_RUN_AMPLITUDE,
                             profile_amplitude[1500]);
    TEST_ASSERT_FLOAT_WITHIN(0.0001F, APP_MOTOR_RUN_AMPLITUDE, drive_u[1500]);
    TEST_ASSERT_FLOAT_WITHIN(0.0001F, APP_MOTOR_RUN_AMPLITUDE, drive_v[1500]);
    TEST_ASSERT_FLOAT_WITHIN(0.0001F, APP_MOTOR_RUN_AMPLITUDE, drive_w[1500]);

    TEST_ASSERT_FLOAT_WITHIN(0.0001F, 0.0F, profile_frequency[1699]);
    TEST_ASSERT_FLOAT_WITHIN(0.0001F, 0.0F, profile_amplitude[1699]);
    TEST_ASSERT_FLOAT_WITHIN(0.0001F, 0.0F, drive_u[1699]);
    TEST_ASSERT_FLOAT_WITHIN(0.0001F, 0.0F, drive_v[1699]);
    TEST_ASSERT_FLOAT_WITHIN(0.0001F, 0.0F, drive_w[1699]);
}
