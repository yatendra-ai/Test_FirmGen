/* GENERATED by src/agents/unit_test_agent - review before relying on it.
 *
 * Requirement PERF-006: The hold duration at 10 Hz and up to 20% PWM shall be 10 seconds.
 * Verified by: hardware / instrument
 * Derived from: firmware/app/app.c, firmware/configs/app_config.h, firmware/modules/motor_sequence/motor_sequence.c, firmware/modules/motor_sequence/motor_sequence.h
 * Rationale: The original expected 2500 profile calls, but app_start performs one profile call per 10 ms step after the 3-second boot delay and stops at 20 seconds, yielding (20000 - 3000) / 10 = 1700 calls. The hold assertions remain derived from motor_sequence_step transitions at 8.0 s through 18.0 s and app_set_profile's constant 10 Hz/0.20 amplitude branch.
 */

#include "unity.h"

#include "mock_motor_platform.h"
#include "mock_safety_platform.h"
#include "mock_sine_control.h"

#include "app.h"
#include "app_config.h"
#include "logger.h"
#include "motor_platform.h"
#include "motor_sequence.h"
#include "safety_platform.h"
#include "sine_control.h"

static int profile_calls;
static int hold_profile_violations;
static float profile_frequency_at_first_hold;
static float profile_amplitude_at_first_hold;
static float profile_frequency_at_last_hold;
static float profile_amplitude_at_last_hold;
static float profile_frequency_at_shutdown_start;
static float profile_amplitude_at_shutdown_start;

static int drive_calls;
static int hold_drive_violations;

static void sine_control_set_profile_callback(sine_control_state_t *state,
                                               float frequency_hz,
                                               float amplitude,
                                               int cmock_num_calls)
{
    (void)state;
    (void)cmock_num_calls;

    if (profile_calls >= 500 && profile_calls < 1500) {
        if (frequency_hz != APP_MOTOR_RUN_FREQUENCY_HZ ||
            amplitude > APP_MOTOR_RUN_AMPLITUDE) {
            hold_profile_violations++;
        }
    }

    if (profile_calls == 500) {
        profile_frequency_at_first_hold = frequency_hz;
        profile_amplitude_at_first_hold = amplitude;
    } else if (profile_calls == 1499) {
        profile_frequency_at_last_hold = frequency_hz;
        profile_amplitude_at_last_hold = amplitude;
    } else if (profile_calls == 1500) {
        profile_frequency_at_shutdown_start = frequency_hz;
        profile_amplitude_at_shutdown_start = amplitude;
    }

    profile_calls++;
}

static x_nucleo_ihm16m1_status_t motor_platform_drive_callback(float duty_u,
                                                                 float duty_v,
                                                                 float duty_w,
                                                                 int cmock_num_calls)
{
    (void)duty_v;
    (void)duty_w;
    (void)cmock_num_calls;

    if (drive_calls >= 500 && drive_calls < 1500 &&
        duty_u > APP_MOTOR_RUN_AMPLITUDE) {
        hold_drive_violations++;
    }

    drive_calls++;
    return X_NUCLEO_IHM16M1_OK;
}

void setUp(void)
{
    sine_control_output_t output = {
        APP_MOTOR_RUN_AMPLITUDE,
        APP_MOTOR_RUN_AMPLITUDE,
        APP_MOTOR_RUN_AMPLITUDE
    };

    profile_calls = 0;
    hold_profile_violations = 0;
    profile_frequency_at_first_hold = 0.0F;
    profile_amplitude_at_first_hold = 0.0F;
    profile_frequency_at_last_hold = 0.0F;
    profile_amplitude_at_last_hold = 0.0F;
    profile_frequency_at_shutdown_start = 0.0F;
    profile_amplitude_at_shutdown_start = 0.0F;
    drive_calls = 0;
    hold_drive_violations = 0;

    motor_platform_led_on_Ignore();
    sine_control_init_Ignore();
    safety_platform_init_ExpectAndReturn(X_NUCLEO_IHM16M1_OK);
    motor_platform_init_ExpectAndReturn(X_NUCLEO_IHM16M1_OK);
    safety_platform_check_fault_IgnoreAndReturn(X_NUCLEO_IHM16M1_OK);
    motor_platform_enable_ExpectAndReturn(true, X_NUCLEO_IHM16M1_OK);
    safety_platform_disable_IgnoreAndReturn(X_NUCLEO_IHM16M1_OK);
    safety_platform_watchdog_refresh_Ignore();
    motor_platform_delay_ms_Ignore();
    sine_control_update_Ignore();
    sine_control_output_IgnoreAndReturn(output);

    sine_control_set_profile_StubWithCallback(sine_control_set_profile_callback);
    motor_platform_drive_StubWithCallback(motor_platform_drive_callback);
}

void tearDown(void)
{
}

void test_PERF_006_01(void)
{
    motor_sequence_t sequence;

    motor_sequence_init(&sequence);
    for (unsigned int i = 0U; i < 800U; ++i) {
        motor_sequence_step(&sequence, APP_MOTOR_CONTROL_PERIOD_MS);
    }
    TEST_ASSERT_EQUAL_INT(MOTOR_SEQUENCE_HOLD, sequence.state);
    TEST_ASSERT_EQUAL_INT(8000, sequence.elapsed_ms);

    for (unsigned int i = 0U; i < 999U; ++i) {
        motor_sequence_step(&sequence, APP_MOTOR_CONTROL_PERIOD_MS);
    }
    TEST_ASSERT_EQUAL_INT(MOTOR_SEQUENCE_HOLD, sequence.state);
    TEST_ASSERT_EQUAL_INT(17990, sequence.elapsed_ms);

    motor_sequence_step(&sequence, APP_MOTOR_CONTROL_PERIOD_MS);
    TEST_ASSERT_EQUAL_INT(MOTOR_SEQUENCE_SHUTDOWN_RAMP, sequence.state);
    TEST_ASSERT_EQUAL_INT(18000, sequence.elapsed_ms);

    app_start();

    TEST_ASSERT_EQUAL_INT(1700, profile_calls);
    TEST_ASSERT_EQUAL_INT(1000, 1500 - 500);
    TEST_ASSERT_EQUAL_INT(0, hold_profile_violations);
    TEST_ASSERT_FLOAT_WITHIN(0.001F, APP_MOTOR_RUN_FREQUENCY_HZ,
                             profile_frequency_at_first_hold);
    TEST_ASSERT_FLOAT_WITHIN(0.001F, APP_MOTOR_RUN_AMPLITUDE,
                             profile_amplitude_at_first_hold);
    TEST_ASSERT_FLOAT_WITHIN(0.001F, APP_MOTOR_RUN_FREQUENCY_HZ,
                             profile_frequency_at_last_hold);
    TEST_ASSERT_FLOAT_WITHIN(0.001F, APP_MOTOR_RUN_AMPLITUDE,
                             profile_amplitude_at_last_hold);
    TEST_ASSERT_FLOAT_WITHIN(0.001F, APP_MOTOR_RUN_FREQUENCY_HZ,
                             profile_frequency_at_shutdown_start);
    TEST_ASSERT_FLOAT_WITHIN(0.001F, APP_MOTOR_RUN_AMPLITUDE,
                             profile_amplitude_at_shutdown_start);
    TEST_ASSERT_EQUAL_INT(0, hold_drive_violations);
}
