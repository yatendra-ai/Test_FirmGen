/* GENERATED by src/agents/unit_test_agent - review before relying on it.
 *
 * Requirement PERF-005: The maximum PWM amplitude during the demo shall be 20%.
 * Verified by: hardware / instrument
 * Derived from: firmware/app/app.c, firmware/configs/app_config.h
 * Rationale: The first test exercises the three elapsed-time branches in app_set_profile(), including the start ramp, run hold, and shutdown ramp, and checks that every resulting amplitude is no greater than APP_MOTOR_RUN_AMPLITUDE (0.20). The second test exercises the shutdown-ramp calculation at 20 s, where the ramp ratio is clamped and the computed amplitude is zero.
 */

#include "unity.h"
#include "mock_motor_platform.h"
#include "mock_motor_sequence.h"
#include "mock_safety_platform.h"
#include "mock_sine_control.h"
#include "app.h"
#include "app_config.h"
#include "logger.h"
#include "motor_platform.h"
#include "motor_sequence.h"
#include "safety_platform.h"
#include "sine_control.h"

#include <string.h>

/* Include the implementation so the static profile function is testable. */
#include "app.c"

static float recorded_amplitudes[16];
static unsigned int recorded_amplitude_count;

static void record_profile_callback(sine_control_state_t *state,
                                    float frequency_hz,
                                    float amplitude,
                                    int cmock_num_calls)
{
    (void)state;
    (void)frequency_hz;
    (void)cmock_num_calls;

    if (recorded_amplitude_count < (sizeof(recorded_amplitudes) /
                                    sizeof(recorded_amplitudes[0]))) {
        recorded_amplitudes[recorded_amplitude_count] = amplitude;
        recorded_amplitude_count++;
    }
}

void setUp(void)
{
    memset(recorded_amplitudes, 0, sizeof(recorded_amplitudes));
    recorded_amplitude_count = 0U;
}

void tearDown(void)
{
}

void test_PERF_005_01(void)
{
    sine_control_state_t state;
    const uint32_t observation_times_ms[] = {
        0U,
        2999U,
        APP_MOTOR_START_RAMP_MS,
        APP_MOTOR_START_RAMP_MS + APP_MOTOR_HOLD_MS - 1U,
        APP_MOTOR_START_RAMP_MS + APP_MOTOR_HOLD_MS,
        16000U,
        19000U,
        20000U
    };
    unsigned int i;

    sine_control_set_profile_StubWithCallback(record_profile_callback);

    for (i = 0U; i < (sizeof(observation_times_ms) /
                      sizeof(observation_times_ms[0])); i++) {
        app_set_profile(&state, observation_times_ms[i]);
    }

    TEST_ASSERT_EQUAL_INT((int)(sizeof(observation_times_ms) /
                                sizeof(observation_times_ms[0])),
                          (int)recorded_amplitude_count);

    for (i = 0U; i < recorded_amplitude_count; i++) {
        TEST_ASSERT_TRUE(recorded_amplitudes[i] <= APP_MOTOR_RUN_AMPLITUDE);
    }
}

void test_PERF_005_02(void)
{
    sine_control_state_t state;

    sine_control_set_profile_StubWithCallback(record_profile_callback);

    /* At t = 20 s the shutdown-ramp calculation is clamped to zero. */
    app_set_profile(&state, 20000U);

    TEST_ASSERT_EQUAL_INT(1, (int)recorded_amplitude_count);
    TEST_ASSERT_FLOAT_WITHIN(0.000001F, 0.0F, recorded_amplitudes[0]);
}
